## conf/layer.conf
```bitbake
BBPATH .= ":${LAYERDIR}"

BBFILES += "${LAYERDIR}/recipes-*/*/*.bb \
            ${LAYERDIR}/recipes-*/*/*.bbappend"

BBFILE_COLLECTIONS += "installer_raylib"
BBFILE_PATTERN_installer_raylib = "^${LAYERDIR}/"
BBFILE_PRIORITY_installer_raylib = "6"

LAYERSERIES_COMPAT_installer_raylib = "blacksail"
```
